// Infinity Kernel - Device Tree Overlay for Poco X3 Pro
// Charging Control Node
// Apply to: arch/arm64/boot/dts/qcom/sm7325-poco-vayu.dts

&soc {
	infinity_charging: infinity_charging {
		compatible = "xiaomi,infinity-charging-vayu", "qcom,infinity-charging";
		status = "okay";

		max-charge-current = <3000>;      // 3A max charge current
		gaming-charge-current = <500>;    // 500mA during gaming
		cooldown-threshold = <45000>;     // 45°C - enter cooling mode
		resume-threshold = <40000>;       // 40°C - resume normal charging

		pinctrl-names = "default", "sleep";
		pinctrl-0 = <&charging_ctrl_active>;
		pinctrl-1 = <&charging_ctrl_sleep>;
	};
};