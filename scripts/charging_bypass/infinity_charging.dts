// SPDX-License-Identifier: Apache-2.0
/*
 * Infinity Kernel v1.0.49
 * Poco X3 Pro (vayu/bhima) | SM8150
 * Clang 23 | KernelSU-Next | SuSFS | Linux 4.14
 */

/dts-v1/;

/ {
	compatible = "qcom,sm8150";
	model = "Infinity Kernel Charging Control";
};